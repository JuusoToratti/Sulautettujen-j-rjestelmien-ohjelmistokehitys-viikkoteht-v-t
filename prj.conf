## CMakeLists.txt
```
cmake_minimum_required(VERSION 3.20.0)
find_package(Zephyr REQUIRED HINTS $ENV{ZEPHYR_BASE})

project(Viikkotehtava5kolmenpisteenarvoinen)

target_sources(app PRIVATE src/main.c)
target_sources(app PRIVATE src/seq_parser.c)
target_sources(app PRIVATE
  src/main.c
  src/seq_parser.c
  src/TimeParser.c
)
target_include_directories(app PRIVATE src)
```

## prj.conf
```kconfig
CONFIG_SERIAL=y
CONFIG_UART_CONSOLE=y
CONFIG_UART_INTERRUPT_DRIVEN=y

CONFIG_HEAP_MEM_POOL_SIZE=1024
CONFIG_MINIMAL_LIBC_MALLOC=y
```

## src/TimeParser.c
```c
#include <stdlib.h>
#include <string.h>
#include "TimeParser.h"
#include <ctype.h>
#include <zephyr/sys/printk.h>

// Virhekoodit:
#define TIME_LEN_ERROR   -1
#define TIME_ZERO_ERROR  -2
#define TIME_CHAR_ERROR  -3
#define TIME_HOUR_ERROR  -4
#define TIME_MIN_ERROR   -5
#define TIME_SEC_ERROR   -6
#define TIME_NULL_ERROR  -10  // ei käytetä testeissä, mutta mukana varmuuden vuoksi

// --- time_parse ---
// Palauttaa sekuntimäärän (0–86399) tai negatiivisen virhekoodin
int time_parse(const char *time)
{
    if (time == NULL) {
        return TIME_NULL_ERROR;
    }

    int len = strlen(time);
    if (len != 6) {
        return TIME_LEN_ERROR;  // liian lyhyt tai pitkä
    }

    // Tarkista että kaikki merkit ovat numeroita
    for (int i = 0; i < 6; i++) {
        if (!isdigit((unsigned char)time[i])) {
            return TIME_CHAR_ERROR;
        }
    }

    char buf[3];
    buf[2] = '\0';

    strncpy(buf, time, 2);
    int hh = atoi(buf);

    strncpy(buf, time + 2, 2);
    int mm = atoi(buf);

    strncpy(buf, time + 4, 2);
    int ss = atoi(buf);

    // Tarkista aikakomponentit
    if (hh < 0 || hh > 23) {
        return TIME_HOUR_ERROR;
    }
    if (mm < 0 || mm > 59) {
        return TIME_MIN_ERROR;
    }
    if (ss < 0 || ss > 59) {
        return TIME_SEC_ERROR;
    }

    // Tarkista nolla-aika
    if (hh == 0 && mm == 0 && ss == 0) {
        return TIME_ZERO_ERROR;
    }

    // Lasketaan sekunnit
    int total = hh * 3600 + mm * 60 + ss;
    return total;
}
```

## src/Timeparser.h
```c
#pragma once
#ifndef TIMEPARSER_H
#define TIMEPARSER_H

#ifdef __cplusplus
extern "C" {
#endif

/* Palautusarvot:
 * >= 0 : aika sekunteina
 * <  0 : virhekoodit
 */
#define TIME_NULL_ERROR   -1   /* NULL pointteri */
#define TIME_LEN_ERROR    -2   /* väärä pituus */
#define TIME_CHAR_ERROR   -3   /* ei-numero merkkejä */
#define TIME_HOUR_ERROR   -4   /* tunnit virheelliset */
#define TIME_MIN_ERROR    -5   /* minuutit virheelliset */
#define TIME_SEC_ERROR    -6   /* sekunnit virheelliset */
#define TIME_ZERO_ERROR   -7   /* aika-arvo ei saa olla 0 */

/* Funktio: parsii merkkijonon muodossa "HHMMSS" */
int time_parse(const char *time);

#ifdef __cplusplus
}
#endif

#endif /* TIMEPARSER_H */
```

## src/seq_parser.c
```c
#include <zephyr/kernel.h>
#include <zephyr/sys/printk.h>
#include "seq_parser.h"
#include <string.h>
#include <ctype.h>

#define SEQ_INVALID_CHAR_ERROR  -7
#define SEQ_EMPTY_ERROR         -8
#define SEQ_TOO_LONG_ERROR      -9

#define VALID_CHARS "RYG"
#define MAX_SEQ_LEN 20

int parse_sequence(const char *input, struct seq_item *items, int max_items, int *out_count) {
    *out_count = 0;

    if (input == NULL || strlen(input) == 0) {
        printk("%dX", SEQ_EMPTY_ERROR);
        return SEQ_EMPTY_ERROR;
    }

    if (strlen(input) > MAX_SEQ_LEN) {
        printk("%dX", SEQ_TOO_LONG_ERROR);
        return SEQ_TOO_LONG_ERROR;
    }

    const char *p = input;
    while (*p && *out_count < max_items) {
        if (strchr(VALID_CHARS, *p) == NULL) {
            printk("%dX", SEQ_INVALID_CHAR_ERROR);
            return SEQ_INVALID_CHAR_ERROR;
        }
        items[*out_count].color = *p;
        items[*out_count].duration_ms = 500;
        (*out_count)++;
        p++;
    }

    printk("0X");
    return 0;
}
```

## src/seq_parser.h
```c
// src/seq_parser.h
#pragma once
#include <zephyr/kernel.h>

struct seq_item {
    char color;         // 'R','Y','G'
    int duration_ms;    // millisekunneissa
};

int parse_sequence(const char *input, struct seq_item *items, int max_items, int *out_count);
```
