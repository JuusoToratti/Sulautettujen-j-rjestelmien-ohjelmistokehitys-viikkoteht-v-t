## CMakeLists.txt
```
cmake_minimum_required(VERSION 3.20.0)
find_package(Zephyr REQUIRED HINTS $ENV{ZEPHYR_BASE})
project(seq_parser_tests)

# Lisää parserin lähdekoodi ja testit
target_sources(app PRIVATE
  ../../src/seq_parser.c
  src/test_seq_parser.c
)

# Lisää include-hakemisto, jotta testit löytävät seq_parser.h
target_include_directories(app PRIVATE ../../src)
```

## prj.conf
```kconfig
# Zephyr test environment
CONFIG_ZTEST=y
CONFIG_TEST=y

# Stack ja heapit hieman isommiksi testejä varten
CONFIG_MAIN_STACK_SIZE=4096
CONFIG_HEAP_MEM_POOL_SIZE=8192

# UART-konsoli (nRF5340 Audio tukee tätä)
CONFIG_SERIAL=y
CONFIG_CONSOLE=y
CONFIG_UART_CONSOLE=y

# Ei Bluetoothia, ei verkkoa testejä varten
CONFIG_BT=n
CONFIG_NETWORKING=n
```

## src/test_seq_parser.c
```c
#include <zephyr/ztest.h>
#include "seq_parser.h"

ZTEST(seq_parser, test_simple_letters)
{
    struct seq_item items[10];
    int count;
    int ret = parse_sequence("RYG", items, 10, &count);

    zassert_equal(ret, 0, "Parser failed");
    zassert_equal(count, 3, "Wrong count");
    zassert_equal(items[0].color, 'R', "Wrong color");
    zassert_equal(items[1].color, 'Y', "Wrong color");
    zassert_equal(items[2].color, 'G', "Wrong color");
}

ZTEST(seq_parser, test_with_durations)
{
    struct seq_item items[10];
    int count;
    int ret = parse_sequence("R,1000,Y,500,G,1000", items, 10, &count);

    zassert_equal(ret, 0, "Parser failed");
    zassert_equal(count, 3, "Wrong count");
    zassert_equal(items[0].duration_ms, 1000, "Wrong duration");
    zassert_equal(items[1].duration_ms, 500, "Wrong duration");
    zassert_equal(items[2].duration_ms, 1000, "Wrong duration");
}

ZTEST(seq_parser, test_invalid_char)
{
    struct seq_item items[10];
    int count;
    int ret = parse_sequence("RXG", items, 10, &count);

    zassert_not_equal(ret, 0, "Should fail for invalid char");
}

ZTEST_SUITE(seq_parser, NULL, NULL, NULL, NULL, NULL);
```
